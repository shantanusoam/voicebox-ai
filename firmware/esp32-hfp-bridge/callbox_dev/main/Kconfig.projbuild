## firmware/esp32-hfp-bridge/callbox_dev/main/Kconfig.projbuild
```kconfig
menu "CallBox Device Configuration"

    config CB_WIFI_SSID
        string "Wi-Fi SSID"
        default "callbox-lab"

    config CB_WIFI_PASS
        string "Wi-Fi password"
        default ""

    config CB_SERVER_URI
        string "CallBox WebSocket URI"
        default "ws://192.168.1.10:8787/ws/device"

    config CB_DEVICE_ID
        string "Device ID from POST /api/devices"
        default "dev_REPLACE"

    config CB_DEVICE_TOKEN
        string "Device token from POST /api/devices"
        default "REPLACE_ME"

    config CB_TEST_FRAMES
        int "Synthetic frames to send in echo test"
        default 150

endmenu
```

## firmware/esp32-hfp-bridge/callbox_hfp/main/Kconfig.projbuild
```kconfig
menu "CallBox Device Configuration"

    config CB_WIFI_SSID
        string "Wi-Fi SSID"
        default "callbox-lab"

    config CB_WIFI_PASS
        string "Wi-Fi password"
        default ""

    config CB_SERVER_URI
        string "CallBox WebSocket URI"
        default "ws://<PC-LAN-IP>:8787/ws/device"

    config CB_DEVICE_ID
        string "Device ID from POST /api/devices"
        default "dev_REPLACE"

    config CB_DEVICE_TOKEN
        string "Device token from POST /api/devices"
        default "REPLACE_ME"

    config CB_CALL_MODE
        string "Call mode: local_echo, local_tone, echo or agent"
        default "echo"
        help
            local_echo bypasses Wi-Fi/WebSocket and loops received mSBC packets
            directly back to the phone. local_tone sends a generated mSBC
            test tone back to the phone using the incoming SCO packet cadence.
            Use these to prove HFP/SCO transmit independently before debugging
            the network bridge.

    config CB_DOWNLINK_CODEC
        string "Downlink codec: binary (PCM) or adpcm (CBB2)"
        default "binary"
        help
            Use binary to compare the bounded PCM queue against the previous
            bridge. Use adpcm to send 164-byte independent 20 ms blocks rather
            than 640-byte PCM frames. Both use the same phone mSBC output.

    config CB_VAD_THRESHOLD
        int "Speech gate RMS threshold (0-32767)"
        default 900

endmenu
```
